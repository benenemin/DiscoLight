## boards/esp32s3_control_board/board.yml
```yaml
board:
  name: esp32s3_control_board
  full_name: ESP32-S3-CONTROL-BOARD
  vendor: other
  socs:
  - name: esp32s3
```

## boards/esp32s3_control_board/esp32s3_control_board_appcpu_defconfig
```kconfig
# SPDX-License-Identifier: Apache-2.0

CONFIG_CLOCK_CONTROL=y
CONFIG_BT_BUF_CMD_TX_COUNT=2
```

## west.yml
```yaml
# Copyright (c) 2021 Nordic Semiconductor ASA
# SPDX-License-Identifier: Apache-2.0

manifest:
  self:
    west-commands: scripts/west-commands.yml

  remotes:
    - name: zephyrproject-rtos
      url-base: https://github.com/zephyrproject-rtos
    - name: espressif
      url-base: https://github.com/espressif

  projects:
    - name: zephyr
      remote: zephyrproject-rtos
      revision: v4.2.0
      import:
        # By using name-allowlist we can clone only the modules that are
        # strictly needed by the application.
        name-allowlist:
          - hal_espressif
          - hal_stm32
          - cmsis_6
          - cmsis-dsp
          - cmsis-nn
          - cmsis
          - mbedtls

    - name: esp-dsp
      remote: espressif
      path: example-application/lib/esp-dsp/modules
```
